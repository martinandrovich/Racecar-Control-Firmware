; ____________________________________________________________________________________________________________________________________________________
; >> BREAK OFFSET TABLE

BREAK_OFFSET_TABLE:
	.DB		18, 10							;  1 Segment	(9-10)
	.DB		36, 16							;  2 Segments	(15-16)
	.DB		55, 20							;  3 Segments	(19-20)
	.DB		73, 24							;  4 Segments	(23-24)
	.DB		91, 26							;  5 Segments	(25-26)
	.DB		109, 28							;  6 Segments	(27-28)
	.DB		128, 30							;  7 Segments	(29-30)
	.DB		146, 31							;  8 Segments	(30-31)
	.DB		164, 33							;  9 Segments	(33-34)
	.DB		182, 34							; 10 Segments	(33-34)
	.DB		201, 34							; 11 Segments
	.DB		219, 35							; 12 Segments
	.DB		237, 35							; 13 Segments
	.DB		252, 35							; 14 Segments
	.DB		0, 35