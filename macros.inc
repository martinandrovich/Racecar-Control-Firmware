
; ____________________________________________________________________________________________________________________________________________________
; >> MACROS

;  _ _ _ _ _ _ _ _ _ _ _ _ _ _ _ _ _ _ _ _ _ _ _ _ _ _ _ _ _ _ _ _ _ _ _ _ _ _ _ _ _ _ _ _ _ _ _ _ _ _ _ _ _ _ _ _ _ _ _ _ _ _ _ _ _ _ _ _ _ _ _ _ _ _
;  > SET FLAG

 .MACRO	SFLG

	MOV		TEMP1, @0														; Clear Flag (@1) of Register (@0)
	SBR		TEMP1, (1<<@1)													; ^
	MOV		@0, TEMP1														; ^

.ENDMACRO

;  _ _ _ _ _ _ _ _ _ _ _ _ _ _ _ _ _ _ _ _ _ _ _ _ _ _ _ _ _ _ _ _ _ _ _ _ _ _ _ _ _ _ _ _ _ _ _ _ _ _ _ _ _ _ _ _ _ _ _ _ _ _ _ _ _ _ _ _ _ _ _ _ _ _
;  > CLEAR FLAG

 .MACRO	CFLG

	MOV		TEMP1, @0														; Clear Flag (@1) of Register (@0)
	CBR		TEMP1, (1<<@1)													; ^
	MOV		@0, TEMP1														; ^

.ENDMACRO